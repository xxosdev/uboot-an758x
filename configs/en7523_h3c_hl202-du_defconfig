## configs/en7523_h3c_hl202-du_defconfig
```kconfig
CONFIG_ARM=y
CONFIG_POSITION_INDEPENDENT=y
CONFIG_SYS_ARCH_TIMER=y
CONFIG_ARCH_AIROHA=y
CONFIG_TARGET_EN7523=y
CONFIG_AIROHA_UBI_ENV=y
CONFIG_AIROHA_HTTP_RECOVERY=y
CONFIG_TEXT_BASE=0x81E00000
CONFIG_SYS_MALLOC_F_LEN=0x4000
CONFIG_NR_DRAM_BANKS=1
CONFIG_DM_GPIO=y
CONFIG_GPIO_HOG=y
CONFIG_BUTTON=y
CONFIG_BUTTON_GPIO=y
CONFIG_DEFAULT_DEVICE_TREE="airoha/en7523-h3c-hl202-du"
CONFIG_SYS_LOAD_ADDR=0x81800000
CONFIG_BUILD_TARGET="u-boot.bin"
# EFI_LOADER defaults to y on ARM, which also drags in TOOLS_MKEFICAPSULE,
# a host tool that needs gnutls. This box boots from UBI and has no use for
# EFI capsules; every other airoha board disables it the same way.
# CONFIG_EFI_LOADER is not set
CONFIG_FIT=y
CONFIG_FIT_VERBOSE=y
CONFIG_BOOTDELAY=3
CONFIG_AUTOBOOT_KEYED=y
CONFIG_AUTOBOOT_MENU_SHOW=y
CONFIG_USE_PREBOOT=y
CONFIG_DEFAULT_FDT_FILE="en7523-h3c-hl202-du"
CONFIG_SYS_PBSIZE=1049
CONFIG_SYS_CONSOLE_IS_IN_ENV=y
# CONFIG_DISPLAY_BOARDINFO is not set
CONFIG_HUSH_PARSER=y
CONFIG_SYS_PROMPT="HL202-DU> "
CONFIG_SYS_MAXARGS=16
CONFIG_CMD_BOOTZ=y
CONFIG_CMD_BOOTMENU=y
CONFIG_CMD_ASKENV=y
CONFIG_CMD_BIND=y
CONFIG_CMD_DM=y
CONFIG_CMD_GPIO=y
CONFIG_CMD_PART=y
CONFIG_CMD_CACHE=y
CONFIG_CMD_MII=y
CONFIG_CMD_MDIO=y
CONFIG_CMD_MTDPARTS=y
CONFIG_CMD_EXT4=y
CONFIG_CMD_FAT=y
CONFIG_CMD_FS_GENERIC=y
CONFIG_ENV_SOURCE_FILE="en7523_h3c_hl202-du"
CONFIG_OF_UPSTREAM=y
# CONFIG_ENV_IS_IN_MTD is not set
CONFIG_NET_RANDOM_ETHADDR=y
CONFIG_SYS_RX_ETH_BUFFER=8
CONFIG_CLK=y
CONFIG_DMA=y
CONFIG_LED=y
CONFIG_LED_GPIO=y
# CONFIG_MMC is not set
CONFIG_MTD_SPI_NAND=y
CONFIG_MTD_UBI_FASTMAP=y
CONFIG_MTD_UBI_FASTMAP_AUTOCONVERT=1
CONFIG_DM_MDIO=y
CONFIG_AIROHA_ETH=y
CONFIG_PHY=y
CONFIG_PINCTRL=y
CONFIG_PINCTRL_AIROHA_EN7523=y
CONFIG_PINCONF=y
CONFIG_RAM=y
CONFIG_DM_SERIAL=y
CONFIG_SYS_NS16550=y
CONFIG_SPI=y
CONFIG_DM_SPI=y
CONFIG_AIROHA_SNFI_SPI=y
# CONFIG_UBIFS_SILENCE_MSG is not set
CONFIG_SHA512=y
```
